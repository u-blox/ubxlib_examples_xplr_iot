## CMakeLists.txt
```
# Copyright 2022 u-blox
#
# Licensed under the Apache License, Version 2.0 (the "License");
# you may not use this file except in compliance with the License.
# You may obtain a copy of the License at
#
#  http://www.apache.org/licenses/LICENSE-2.0
#
# Unless required by applicable law or agreed to in writing, software
# distributed under the License is distributed on an "AS IS" BASIS,
# WITHOUT WARRANTIES OR CONDITIONS OF ANY KIND, either express or implied.
# See the License for the specific language governing permissions and
# limitations under the License.

cmake_minimum_required(VERSION 3.13.1)
set(EXT_FS 1)
include(../common.cmake)
project(application)
```

## prj.conf
```kconfig
# Copyright 2022 u-blox
#
# Licensed under the Apache License, Version 2.0 (the "License");
# you may not use this file except in compliance with the License.
# You may obtain a copy of the License at
#
#  http://www.apache.org/licenses/LICENSE-2.0
#
# Unless required by applicable law or agreed to in writing, software
# distributed under the License is distributed on an "AS IS" BASIS,
# WITHOUT WARRANTIES OR CONDITIONS OF ANY KIND, either express or implied.

# Need to enable stack free functions
CONFIG_INIT_STACKS=y
CONFIG_THREAD_STACK_INFO=y
CONFIG_THREAD_NAME=y
CONFIG_SPI=y

# There are two theads per app task (task+queue).
# So here we need to make sure there are enough threads.
CONFIG_COMPILER_OPT="-DU_CFG_OS_MAX_THREADS=20"
```

## src/main.c
```c
/*
 * Copyright 2022 u-blox
 *
 * Licensed under the Apache License, Version 2.0 (the "License");
 * you may not use this file except in compliance with the License.
 * You may obtain a copy of the License at
 *
 * http://www.apache.org/licenses/LICENSE-2.0
 *
 * Unless required by applicable law or agreed to in writing, software
 * distributed under the License is distributed on an "AS IS" BASIS,
 * WITHOUT WARRANTIES OR CONDITIONS OF ANY KIND, either express or implied.
 * See the License for the specific language governing permissions and
 * limitations under the License.
 */

/*
 *
 * Example showing how to use the buttons and leds in the XPLR-IOT-1
 *
 */

#include "common.h"
#include "ext_fs.h"
#include "leds.h"
#include "buttons.h"

#include "LEDTask.h"
#include "mqttTask.h"
#include "registrationTask.h"
#include "signalQualityTask.h"
#include "cellScanTask.h"
#include "exampleTask.h"

/* ----------------------------------------------------------------
 * DEFINES
 * -------------------------------------------------------------- */

#define STARTUP_DELAY 250        // 250 * 20ms => 5 seconds
#define LOG_FILENAME "log.csv"

#define TASK_CONFIG(task) tasks[task].config
#define IS_TASK_RUNNING(task) isTaskRunning(TASK_CONFIG(task).handles.mutexHandle)

/* ----------------------------------------------------------------
 * TYPE DEFINITIONS
 * -------------------------------------------------------------- */

typedef struct {
    const char *topicName;
    uMqttQos_t qos;
    void (*callbackFunction)(const char *, size_t);
} topicCallback_t;

typedef enum {
    NO_BUTTON=-1,
    BUTTON_1=0,
    BUTTON_2=1
} buttonNumber_t;

// enum of task types - make sure this is in the same
// order as the taskRunner_t tasks initialiser below!
typedef enum {
    NETWORK_REG_TASK = 0,
    CELL_SCAN_TASK = 1,
    MQTT_TASK = 2,
    SIGNAL_QUALITY_TASK = 3,
    LED_TASK = 4,
    EXAMPLE_TASK = 5,
    MAX_TASKS
} taskTypeId_t;

/* ----------------------------------------------------------------
 * GLOBAL VARIABLES
 * -------------------------------------------------------------- */

applicationStates_t gAppStatus = MANUAL;

// serial number of the module
char gSerialNumber[U_SECURITY_SERIAL_NUMBER_MAX_LENGTH_BYTES];

// deviceHandle is not static as this is shared between other modules.
uDeviceHandle_t gDeviceHandle;

// This flag is set to true when the application should close tasks and log files.
// This flag is set to true when Button #1 is pressed.
bool gExitApp = false;

/* ----------------------------------------------------------------
 * STATIC VARIABLES
 * -------------------------------------------------------------- */

static uDeviceType_t deviceType = U_DEVICE_TYPE_CELL;
static uDeviceCfg_t deviceCfg;

static bool buttonCommandEnabled = false;
static buttonNumber_t pressedButton = NO_BUTTON;

// These task runners define the application.
// Here we specify what tasks are to run, and what configuration they are to use
taskRunner_t tasks[] = {
    {startNetworkRegistrationTask, stopNetworkRegistrationTask, {"Registration", NULL, {NULL, NULL, 0}}},
    {startCellScanTask, stopCellScanTask, {"Cell Scan", NULL, {NULL, NULL, 0}}},
    {startMQTTTask, stopMQTTTask, {"MQTT", NULL, {NULL, NULL, 0}}},
    {startSignalQualityTask, stopSignalQualityTask, {"Signal Quality", NULL, {NULL, NULL, 0}}},
    {startLEDTask, stopLEDTask, {"LED", NULL, {NULL, NULL, 0}}},
    {startExampleTask, stopExampleTask, {"Example", NULL, {NULL, NULL, 0}}}
};

/* ----------------------------------------------------------------
 * STATIC FUNCTIONS
 * -------------------------------------------------------------- */

/// @brief Handler for the buttons. On boot, Button 1: Display log, 2: Delete log.
static void button_pressed(int buttonNo, uint32_t holdTime)
{
    if (gExitApp)
        return;

    if (!holdTime) {
        pressedButton = buttonNo;
    } else {
        pressedButton = NO_BUTTON;
        if (!buttonCommandEnabled)
            return;

        switch (buttonNo)
        {
        case BUTTON_1:
            writeLog("Exit button pressed, closing down...");
            gExitApp = true;
            break;
        case BUTTON_2:
            startNetworkScan(gSerialNumber);
            break;
        default:
            break;
        }
    }
}

/// @brief Function to check for a held button at start up.
/// @return The button that was held at start up.
static buttonNumber_t checkStartButton(void) {
    ledSet(2, true);
    // wait for 5 seconds, or if a button is pressed
    for(int i = 0; pressedButton == NO_BUTTON && i < STARTUP_DELAY; i++)
        uPortTaskBlock(20);
    ledSet(2, false);

    buttonNumber_t heldButton = pressedButton;
    if (heldButton == NO_BUTTON)
        return NO_BUTTON;

    // turn on the correct LED for the operation
    int led = 0;  // Delete log file = red
    if (heldButton == BUTTON_1)
        led = 1; // Display log file = green
    ledSet(led, true);

    // wait until the button is released
    while(pressedButton != NO_BUTTON)
        uPortTaskBlock(20);

    return heldButton;
}

/// @brief Reads the serial number from the module
/// @return The length of the serial number, or negative on error
static int32_t getSerialNumber(void)
{
    int32_t len = uSecurityGetSerialNumber(gDeviceHandle, gSerialNumber);
    if (len > 0) {
        if (gSerialNumber[0] == '"') {
            // Remove quotes
            memmove(gSerialNumber, gSerialNumber + 1, len);
            gSerialNumber[len - 2] = 0;
        }

        writeLog("Cellular Module Serial Number: %s", gSerialNumber);
    }

    return len;
}

/// @brief Initiate the UBXLIX API
static int32_t initDevice(void) {
    int32_t errorCode;

    // turn off the UBXLIB printf() logging
    uPortLogOff();

    writeLog("Initiating the UBXLIB Device API...");
    errorCode = uDeviceInit();
    if (errorCode != 0) {
        writeLog("* Failed to initiate the UBXLIB device API: %d", errorCode);
        return errorCode;
    }

    uDeviceGetDefaults(deviceType, &deviceCfg);

    writeLog("Opening/Turning on the cellular module...");
    errorCode = uDeviceOpen(&deviceCfg, &gDeviceHandle);
    if (errorCode != 0) {
        writeLog("* Failed to turn on the cellular module: %d", errorCode);
        return errorCode;
    }

    // get serial number
    errorCode = getSerialNumber();
    if (errorCode < 0) {
        writeLog("* Failed to get the serial number of the module: %d", errorCode);
        return errorCode;
    }

    return 0;
}

/// @brief Checks the "isTaskRunningxxxx()" functions and returns when the tasks have all stopped.
static void waitForTasksToStop(taskConfig_t *taskConfigs, size_t numTasks)
{
    bool stillWaiting;

    printf("Waiting for the tasks to finish...\n");
    do
    {
        stillWaiting = false;

        for(int i=0; i<numTasks; i++) {
            if (isTaskRunning(taskConfigs[i].handles.mutexHandle)) {
                printf("Still waiting for %s task to finish...\n", taskConfigs[i].name);
                stillWaiting = true;
            }
        }

        uPortTaskBlock(2000);
    } while (stillWaiting);

    printf("All tasks are now finished...\n");
}

/// @brief Blocking function while waiting for the task to finish
/// @param taskConfig The task Configuration to wait for
static void waitForTaskToStop(taskConfig_t taskConfig)
{
    while(isTaskRunning(taskConfig.handles.mutexHandle)) {
        writeLog("Waiting for %s task to stop...", taskConfig.name);
        uPortTaskBlock(2000);
    }

    writeLog("%s task has stopped.", taskConfig.name);
}

/// @brief Sets the application status, waits for the tasks and closes the log
/// @param appState The application status to set for the shutdown
static void finalise(applicationStates_t appState)
{
    gAppStatus = appState;
    gExitApp = true;

    // Tell the common tasks to finish first
    taskConfig_t checkTasks[] = {TASK_CONFIG(SIGNAL_QUALITY_TASK),
                                TASK_CONFIG(MQTT_TASK),
                                TASK_CONFIG(CELL_SCAN_TASK),
                                TASK_CONFIG(EXAMPLE_TASK)};

    waitForTasksToStop(checkTasks, ARRAYSIZE(checkTasks));

    // now stop the network registration task
    stopNetworkRegistrationTask();
    waitForTaskToStop(TASK_CONFIG(NETWORK_REG_TASK));

    // nothing left to do, so close the log
    closeLog();

    // finally stop the LED task
    tasks[LED_TASK].stopFunc();
    waitForTaskToStop(TASK_CONFIG(LED_TASK));

    printf("Application has finished.\n");
}

static int32_t runTasks(taskRunner_t *pTaskRunner, size_t numRunners)
{
    int32_t errorCode;

    for(int i=0; i<numRunners; i++) {
        if (IS_TASK_RUNNING(i))
            continue;

        errorCode = pTaskRunner->startFunc(&pTaskRunner->config);
        if (errorCode != 0) {
            writeLog("* Failed to start the %s task (%d) - not running application!", pTaskRunner->config.name, errorCode);
            return errorCode;
        }

        writeLog("Started %s task", pTaskRunner->config.name);
        pTaskRunner++;
    }

    return 0;
}

static bool initFramework(void)
{
    uPortInit();
    if (!buttonsInit(button_pressed)) {
        printf("* Failed to initiate buttons - not running application!\n");
        return false;
    }
    if (!ledsInit()) {
        printf("* Failed to initiate leds - not running application!\n");
        return false;
    }
    if (!extFsInit()) {
        printf("* Failed to mounth File System - not running application!\n");
        return false;
    }

    // User has chance to hold down a button to delete or display the log
    buttonNumber_t button = checkStartButton();

    // deleting the log file is performed now before the start of the application
    if (button == BUTTON_2) {
        printf("Deleting log file...\n");
        deleteFile(LOG_FILENAME);
    }

    startLogging(LOG_FILENAME);

    // displaying the log file ends the application
    if (button == BUTTON_1) {
        displayLogFile();
        ledSet(1, false);
        printf("Application finished");
        return false;
    }

    // now allow the buttons to run their commands
    buttonCommandEnabled = true;

    return true;
}

static void subscribeToTopic(void *pParam)
{
    topicCallback_t *topicCallback = (topicCallback_t *)pParam;

    // wait until the MQTT Task is up and running
    while(!isTaskRunning(TASK_CONFIG(MQTT_TASK).handles.mutexHandle)) {
        printf("Waiting for MQTT Task to start...\n");
        uPortTaskBlock(500);
    }

    char topicName[50];
    snprintf(topicName, 50, "/%s/%s", gSerialNumber, topicCallback->topicName);

    // the MQTT task is running, but we might not be connected yet so this can fail
    // U_ERROR_COMMON_NOT_INITIALISED is the error if the MQTT client isn't connected yet.
    int32_t errorCode = U_ERROR_COMMON_NOT_INITIALISED;
    while(errorCode == U_ERROR_COMMON_NOT_INITIALISED) {
        errorCode = registerTopicCallBack(topicName, topicCallback->qos, topicCallback->callbackFunction);
        if(errorCode == U_ERROR_COMMON_NOT_INITIALISED) {
            printf("MQTT not connected yet, waiting another 5 seconds...\n");
            uPortTaskBlock(5000);
        }
    }

    if (errorCode != 0) {
        writeLog("Subscribing a callback to topic %s failed with erorr code %d", topicName, errorCode);
    }
}

/* ----------------------------------------------------------------
 * PUBLIC FUNCTIONS - see common.h
 * -------------------------------------------------------------- */

/// @brief Sends a task a message via its event queue
/// @param taskId The TaskId (based on the taskTypeId_t)
/// @param message pointer to the message to send
/// @param msgSize the size of the message to send
/// @return 0 on success, negative on failure
int32_t sendAppTaskMessage(int32_t taskId, const void *pMessage, size_t msgSize)
{
    if (taskId < 0 || taskId >= MAX_TASKS) {
        writeLog("Send App Task [%d] Message Error: Invalid Task Id", taskId);
        return -1;
    }

    int32_t errorCode = uPortEventQueueSendIrq(TASK_CONFIG(taskId).handles.eventQueueHandle, pMessage, msgSize);
    if (errorCode < 0) {
        writeLog("Send App Task [%d] Message Error: Can't send event queue message: %d", taskId, errorCode);
    }

    return errorCode;
}

/// @brief Subscribes a callback function to a topic, waiting for the MQTT task to be online
/// @param taskTopicName The topic name to subscribe to. Appends the serial number
/// @param qos The Quality of Service to use for the subscription
/// @param callbackFunction The callback function
void subscribeToTopicAsync(const char *taskTopicName, uMqttQos_t qos, void (*callbackFunction)(const char *, size_t))
{
    uPortTaskHandle_t handle;

    topicCallback_t topicCallbackInfo = {
        .topicName = taskTopicName,
        .qos = qos,
        .callbackFunction = callbackFunction
    };

    printf("Subscribing to topic %s, from a async thread\n", taskTopicName);

    int32_t errorCode = uPortTaskCreate(subscribeToTopic, NULL, 1024, (void *)&topicCallbackInfo, 1, &handle);
    if (errorCode != 0) {
        writeLog("Can't start topic subscription on %s\n", taskTopicName);
    }

    printf("Finished sending off the subscription thread.\n");
}

static void controlMessageHandler(const char *message, size_t msgSize) {
    printf("Received control message\n");
}

/// @brief Main entry to the application.
/// If Button 1 is held, the log file is displayed.
/// If Button 2 is held, the log file is deleted.
/// In both cases, the application starts as normal after.
void main(void)
{
    int32_t errCode;

    // initialise our LEDs and start up button commmands
    if (!initFramework())
        return;

    /* ************************************************************************
     * Start the LED task first, as this is our only indication anything is running.
     * ************************************************************************/
    writeLog("Starting LED Task...");
    errCode = startLEDTask(&TASK_CONFIG(LED_TASK));
    if (errCode != 0) {
        writeLog("* Failed to start LED task - not running application!");
        return finalise(ERROR);
    }

    /* ************************************************************************
     * Initialisation section for Cellular Module
     * ************************************************************************/

    // initialise the cellular module
    gAppStatus = INIT_DEVICE;
    errCode = initDevice();
    if (errCode != 0) {
        writeLog("* Failed to initialise the cellular module - not running application!");
        return finalise(ERROR);
    }

    /* ************************************************************************
     * Start the application tasks (already running won't be restarted)
     * ************************************************************************ */
    if (runTasks(tasks, ARRAYSIZE(tasks)) != 0) {
        return finalise(ERROR);
    }

    subscribeToTopicAsync("Control", U_MQTT_QOS_AT_MOST_ONCE, controlMessageHandler);

    /* ************************************************************************
     * Application loop and finalisation on exit stage
     * ************************************************************************ */

    while(!gExitApp) {
        printf("\n*************\n");
        printf("** RUNNING **\n");
        printf("*************\n");
        uPortTaskBlock(2000);
    }

    writeLog("Application closing down...");
    finalise(SHUTDOWN);
}
```

## src/LEDTask.c
```c
/*
 * Copyright 2022 u-blox
 *
 * Licensed under the Apache License, Version 2.0 (the "License");
 * you may not use this file except in compliance with the License.
 * You may obtain a copy of the License at
 *
 * http://www.apache.org/licenses/LICENSE-2.0
 *
 * Unless required by applicable law or agreed to in writing, software
 * distributed under the License is distributed on an "AS IS" BASIS,
 * WITHOUT WARRANTIES OR CONDITIONS OF ANY KIND, either express or implied.
 * See the License for the specific language governing permissions and
 * limitations under the License.
 */

/*
 *
 * LED task to light up and flash the three LEDs.
 *
 */

#include "common.h"
#include "LEDTask.h"
#include "leds.h"

/* ----------------------------------------------------------------
 * DEFINES
 * -------------------------------------------------------------- */
#define LED_TASK_STACK_SIZE 1024
#define LED_TASK_PRIORITY 5

/* ----------------------------------------------------------------
 * COMMON TASK VARIABLES
 * -------------------------------------------------------------- */
static bool exitTask = false;
static taskConfig_t *taskConfig;

/* ----------------------------------------------------------------
 * STATIC VARIABLES
 * -------------------------------------------------------------- */

/* ----------------------------------------------------------------
 * PUBLIC VARIABLES
 * -------------------------------------------------------------- */

// Application Status is mapped to this LED configuration array
#define MAX_LEDS 3
ledCfg_t ledStatus[MAX_STATUS][MAX_LEDS] = {
    {ledRedOff, ledGreenOff, ledBlueOff},           // MANUAL
    {ledRedFastPulse, ledGreenOff, ledBlueOff},     // INIT_DEVICE
    {ledRedOff, ledGreenOff, ledBlueBlink},         // REGISTERING
    {ledRedOff, ledGreenPulse, ledBlueOff},         // MQTT_CONNECTING
    {ledRedOff, ledGreenPulse, ledBlueOn},          // COPS_QUERY
    {ledRedFlash, ledGreenFlash, ledBlueOff},       // SEND_SIGNAL_QUALITY
    {ledRedOff, ledGreenOff, ledBlueFlash},         // REGISTRATION_UNKNOWN
    {ledRedOff, ledGreenOff, ledBlueOn},            // REGISTERED
    {ledRedOn, ledGreenOff, ledBlueOff},            // ERROR
    {ledRedOn, ledGreenOn, ledBlueOn},              // SHUTDOWN
    {ledRedOff, ledGreenOn, ledBlueOff},            // MQTT_CONNECTED
    {ledRedOff, ledGreenFlash, ledBlueOff},         // MQTT_DISCONNECTED
    {ledRedOn, ledGreenOn, ledBlueOff},             // START_SIGNAL_QUALITY
};

/* ----------------------------------------------------------------
 * STATIC FUNCTIONS
 * -------------------------------------------------------------- */
static void queueHandler(void *pParam, size_t paramLengthBytes)
{
    // does nothing, at the moment.
}

// LED task loop for turning on and off the LEDs according to the gAppStatus
static void taskloop(void *pParameters)
{
    U_PORT_MUTEX_LOCK(TASK_MUTEX);
    while(!exitTask) {
        int priorityLED = -1;

        // Calculate LED states and select priority LED
        for(int l = 0; l < MAX_LEDS; l++) {
            ledCfg_t *led = &ledStatus[gAppStatus][l];
            led->state = (led->timer < led->duty) != led->invert;
            led->timer = led->timer + ledTick_ms;
            if (led->timer >= led->period)
                led->timer = 0;
            if (priorityLED == -1 && led->priority && led->state)
                priorityLED = led->n;
        }

        // Set each LED state, priority LED overriding others.
        for(int l = 0; l < MAX_LEDS; l++) {
            ledCfg_t *led = &ledStatus[gAppStatus][l];
            if (priorityLED == -1)
                ledSet(led->n, led->state);
            else
                if (priorityLED == led->n)
                    ledSet(led->n, true);
                else
                    ledSet(led->n, false);
        }

        uPortTaskBlock(ledTick_ms);
    }

    // turn off the LEDs
    for(int l = 0; l < MAX_LEDS; l++) {
        ledSet(l, false);
    }

    U_PORT_MUTEX_UNLOCK(TASK_MUTEX);
    printf("LED Task finished.\n");
}

static int32_t initTask(taskConfig_t *config)
{
    int32_t errorCode = uPortTaskCreate(taskloop,
                    TASK_NAME,
                    LED_TASK_STACK_SIZE,
                    NULL,
                    LED_TASK_PRIORITY,
                    &TASK_HANDLE);

    if (errorCode != 0) {
        writeLog("Failed to create the %s Task (%d).",TASK_NAME, errorCode);
    }

    return errorCode;
}

static int32_t initQueue(taskConfig_t *config)
{
    int32_t eventQueueHandle = uPortEventQueueOpen(&queueHandler,
                    TASK_NAME,
                    sizeof(LEDConfigMsg_t),
                    1024,
                    1,
                    1);

    if (eventQueueHandle < 0) {
        writeLog("Failed to create %s event queue %d", TASK_NAME, eventQueueHandle);
    }

    TASK_QUEUE = eventQueueHandle;

    return eventQueueHandle;
}

static int32_t initMutex(taskConfig_t *config)
{
    int32_t errorCode = uPortMutexCreate(&TASK_MUTEX);
    if (errorCode != 0) {
        writeLog("Failed to create the %s Mutex (%d).", TASK_NAME, errorCode);
    }

    return errorCode;
}

/* ----------------------------------------------------------------
 * PUBLIC FUNCTIONS
 * -------------------------------------------------------------- */

// Set individual Manual LED
void setManualLed(int n, ledCfg_t led)
{
    ledStatus[MANUAL][n] = led;
    gAppStatus = MANUAL;
}

// Set all three LEDS manually instead of using the ledStatus mapping above
void setManualLeds(ledCfg_t l1, ledCfg_t l2, ledCfg_t l3)
{
    setManualLed(0, l1);
    setManualLed(1, l2);
    setManualLed(2, l3);
}

// Copies the current LED statuses to the manual LED configuration
void copyLedsToManual()
{
    for(int i = 0; i < MAX_LEDS; i++)
        ledStatus[MANUAL][i] = ledStatus[gAppStatus][i];
}

// Copies current led statuses and updates one LED
void addLedToManual(int n, ledCfg_t led)
{
    copyLedsToManual();
    setManualLed(n, led);
}

/// @brief Starts the LED task(s)
/// @param pParam Any parameter to be sent to the starting of the task
/// @return zero if successfull, a negative number otherwise
int32_t startLEDTask(taskConfig_t *config)
{
    taskConfig = config;

    int32_t result = U_ERROR_COMMON_SUCCESS;

    writeLog("Starting the %s task...", TASK_NAME);
    CHECK_SUCCESS(initTask, config);
    CHECK_SUCCESS(initQueue, config);
    CHECK_SUCCESS(initMutex, config);

    return result;
}

/// @brief Stop the network manager and deregister from the cellular network
void stopLEDTask(void)
{
    exitTask = true;
    writeLog("Stop %s task requested...", taskConfig->name);
}
```

## src/LEDTask.h
```c
/*
 * Copyright 2022 u-blox
 *
 * Licensed under the Apache License, Version 2.0 (the "License");
 * you may not use this file except in compliance with the License.
 * You may obtain a copy of the License at
 *
 * http://www.apache.org/licenses/LICENSE-2.0
 *
 * Unless required by applicable law or agreed to in writing, software
 * distributed under the License is distributed on an "AS IS" BASIS,
 * WITHOUT WARRANTIES OR CONDITIONS OF ANY KIND, either express or implied.
 * See the License for the specific language governing permissions and
 * limitations under the License.
 */

/*
 *
 * LED Task header
 *
 */

#ifndef _LEDTASK_H_
#define _LEDTASK_H_

/* ----------------------------------------------------------------
 * PUBLIC TYPE DEFINITIONS
 * -------------------------------------------------------------- */

// LED configuration
typedef struct {
    int32_t n;          // LED number
    int32_t period;     // time period
    int32_t duty;       // duty cyle of it being on. 0 = off, 50 = half flash, 100 = on
    int32_t timer;      // timer position of the led. 0 = start, timer <= duty: on
    bool invert;        // invert the duty
    bool state;         // state of LED
    bool priority;      // Priority LED
} ledCfg_t;

/* ----------------------------------------------------------------
 * DEFINITIONS
 * -------------------------------------------------------------- */

#define ledTick_ms 10

// Some LED Examples   {LED#, period, duty, pos, invert, state, priority}
#define ledRedOn       {0, 1000, 1000, 0, false, false, false}
#define ledRedOff      {0, 1000, 0,    0, false, false, false}
#define ledGreenOn     {1, 1000, 1000, 0, false, false, false}
#define ledGreenOff    {1, 1000, 0,    0, false, false, false}
#define ledBlueOn      {2, 1000, 1000, 0, false, false, false}
#define ledBlueOff     {2, 1000, 00,   0, false, false, false}

#define ledRedFlash    {0, 100,  50,   0, false, false, false}
#define ledGreenFlash  {1, 100,  50,   0, false, false, false}
#define ledBlueFlash   {2, 100,  50,   0, false, false, false}

#define ledRedPulse    {0, 1000, 750,  0, false, false, false}
#define ledGreenPulse  {1, 1000, 750,  0, false, false, false}
#define ledBluePulse   {2, 1000, 750,  0, false, false, false}

#define ledRedBlink    {0, 1000, 200,  0, false, false, false}
#define ledGreenBlink  {1, 1000, 200,  0, false, false, false}
#define ledBlueBlink   {2, 1000, 200,  0, false, false, false}

#define ledRedBlinkInv    {0, 1000, 200, 0, true, false, false}
#define ledGreenBlinkInv  {1, 1000, 200, 0, true, false, false}
#define ledBlueBlinkInv   {2, 1000, 200, 0, true, false, false}

#define ledRedPulseInv       {0, 1000, 750, 0, true,  false, false}
#define ledRedFastPulse      {0, 500,  100, 0, false, false, false}
#define ledGreenFastPulseInv {1, 500,  100, 0, true,  false, false}
#define ledRedFastPri        {0, 500,  200, 0, false, false, true}

/* ----------------------------------------------------------------
 * COMMON TASK FUNCTIONS
 * -------------------------------------------------------------- */
int32_t startLEDTask(taskConfig_t *config);
void stopLEDTask(void);

/* ----------------------------------------------------------------
 * TASK FUNCTIONS
 * -------------------------------------------------------------- */
void setManualLeds(ledCfg_t l1, ledCfg_t l2, ledCfg_t l3);

/* ----------------------------------------------------------------
 * QUEUE MESSAGE TYPE DEFINITIONS
 * -------------------------------------------------------------- */
typedef struct {
    int32_t LEDNUmber;
    bool state;
} LEDConfigMsg_t;

#endif
```

## src/NTPClient.c
```c
/*
 * Copyright 2022 u-blox
 *
 * Licensed under the Apache License, Version 2.0 (the "License");
 * you may not use this file except in compliance with the License.
 * You may obtain a copy of the License at
 *
 * http://www.apache.org/licenses/LICENSE-2.0
 *
 * Unless required by applicable law or agreed to in writing, software
 * distributed under the License is distributed on an "AS IS" BASIS,
 * WITHOUT WARRANTIES OR CONDITIONS OF ANY KIND, either express or implied.
 * See the License for the specific language governing permissions and
 * limitations under the License.
 */

/*
 *
 * Simple function to return the clock time from a NTP Server
 *
 */

#include <time.h>

#include "common.h"
#include "ntpclient.h"
#include "..\include\zephyr\sys\byteorder.h"

/* ----------------------------------------------------------------
 * DEFINES
 * -------------------------------------------------------------- */

#define ntohl(x)   sys_be32_to_cpu(x)

// Timeout for waiting for NTP is 20 seconds, using a 100ms tick
#define NTP_TIMEOUT 200
#define NTP_SERVER "time.google.com"

#define NTP_TIMESTAMP_DELTA 2208988800ull

/* ----------------------------------------------------------------
 * STATIC VARIABLES
 * -------------------------------------------------------------- */

static bool haveDataToRead = false;

typedef struct
{
  uint8_t li_vn_mode;      // Eight bits. li, vn, and mode.
                           // li.   Two bits.   Leap indicator.
                           // vn.   Three bits. Version number of the protocol.
                           // mode. Three bits. Client will pick mode 3 for client.

  uint8_t stratum;         // Eight bits. Stratum level of the local clock.
  uint8_t poll;            // Eight bits. Maximum interval between successive messages.
  uint8_t precision;       // Eight bits. Precision of the local clock.

  uint32_t rootDelay;      // 32 bits. Total round trip delay time.
  uint32_t rootDispersion; // 32 bits. Max error aloud from primary clock source.
  uint32_t refId;          // 32 bits. Reference clock identifier.

  uint32_t refTm_s;        // 32 bits. Reference time-stamp seconds.
  uint32_t refTm_f;        // 32 bits. Reference time-stamp fraction of a second.

  uint32_t origTm_s;       // 32 bits. Originate time-stamp seconds.
  uint32_t origTm_f;       // 32 bits. Originate time-stamp fraction of a second.

  uint32_t rxTm_s;         // 32 bits. Received time-stamp seconds.
  uint32_t rxTm_f;         // 32 bits. Received time-stamp fraction of a second.

  uint32_t txTm_s;         // 32 bits and the most important field the client cares about. Transmit time-stamp seconds.
  uint32_t txTm_f;         // 32 bits. Transmit time-stamp fraction of a second.

} ntp_packet;              // Total: 384 bits or 48 bytes.

/* ----------------------------------------------------------------
 * STATIC FUNCTIONS
 * -------------------------------------------------------------- */

static void dataCallback(void *pParam)
{
    haveDataToRead = true;
}

static bool waitForSocketData(void)
{
    for(int i = 0; !gExitApp && !haveDataToRead && i < NTP_TIMEOUT; i++)
        uPortTaskBlock(100);

    return haveDataToRead;
}

/* ----------------------------------------------------------------
 * PUBLIC FUNCTIONS
 * -------------------------------------------------------------- */

/// @brief Gets the time from the NTP Service
/// @return zero on failure, otherwise the unix epoch time
int64_t getNTPTime(void)
{
    ntp_packet packet = { 0, 0, 0, 0, 0, 0, 0, 0, 0, 0, 0, 0, 0, 0, 0 };
    memset( &packet, 0, sizeof( ntp_packet ) );

    // Set the first byte's bits to 00,011,011 for li = 0, vn = 3, and mode = 3.
    *( ( char * ) &packet + 0 ) = 0x1b;

    uSockDescriptor_t sock = uSockCreate(gDeviceHandle, U_SOCK_TYPE_DGRAM, U_SOCK_PROTOCOL_UDP);
    if(sock < 0) {
        writeLog("Failed to create UDP socket: %d", sock);
        return sock;
    }

    haveDataToRead = false;
    uSockRegisterCallbackData(sock, &dataCallback, NULL);

    time_t time = 0;
    uSockAddress_t remoteAddress;
    int32_t errorCode = uSockGetHostByName(gDeviceHandle, NTP_SERVER, &(remoteAddress.ipAddress));
    if (errorCode == 0) {
        remoteAddress.port = 123;

        int64_t errorCode = uSockSendTo(sock, &remoteAddress, &packet, sizeof(ntp_packet));
        if (errorCode > 0) {
            if (waitForSocketData()) {
                errorCode = uSockReceiveFrom(sock, NULL, &packet, sizeof( ntp_packet ));
                if (errorCode > 0) {
                    writeLog("Received NTP time from server");
                    packet.txTm_s = ntohl(packet.txTm_s);
                    time = ( time_t ) ( packet.txTm_s - NTP_TIMESTAMP_DELTA );
                } else {
                    writeLog("Failed to read NTP Packet from server: %d", errorCode);
                }
            } else {
                writeLog("Waiting for NTP response timed out.");
            }
        } else {
            writeLog("Failed to send NTP Packet to server: %d", errorCode);
        }
    } else {
        writeLog("Failed to get Time Service IP Address: %d", sock);
    }

    errorCode = uSockClose(sock);
    if (errorCode != 0) {
        writeLog("Failed to close socket: %d", errorCode);
    }

    return time;
}
```

## src/NTPClient.h
```c
/*
 * Copyright 2022 u-blox
 *
 * Licensed under the Apache License, Version 2.0 (the "License");
 * you may not use this file except in compliance with the License.
 * You may obtain a copy of the License at
 *
 * http://www.apache.org/licenses/LICENSE-2.0
 *
 * Unless required by applicable law or agreed to in writing, software
 * distributed under the License is distributed on an "AS IS" BASIS,
 * WITHOUT WARRANTIES OR CONDITIONS OF ANY KIND, either express or implied.
 * See the License for the specific language governing permissions and
 * limitations under the License.
 */

/*
 *
 * NTP Client header
 *
 */

int64_t getNTPTime(void);
```

## src/cellScanTask.c
```c
/*
 * Copyright 2022 u-blox
 *
 * Licensed under the Apache License, Version 2.0 (the "License");
 * you may not use this file except in compliance with the License.
 * You may obtain a copy of the License at
 *
 * http://www.apache.org/licenses/LICENSE-2.0
 *
 * Unless required by applicable law or agreed to in writing, software
 * distributed under the License is distributed on an "AS IS" BASIS,
 * WITHOUT WARRANTIES OR CONDITIONS OF ANY KIND, either express or implied.
 * See the License for the specific language governing permissions and
 * limitations under the License.
 */

/*
 *
 * Cell Scan Task to run the +COPS=? Query and publish the results
 *
 */

#include "common.h"
#include "cellScanTask.h"
#include "mqttTask.h"

/* ----------------------------------------------------------------
 * DEFINES
 * -------------------------------------------------------------- */
#define NETWORK_SCAN_TOPIC "NetworkScan"

#define CELL_SCAN_TASK_STACK_SIZE (3*1024)
#define CELL_SCAN_TASK_PRIORITY 5

#define CELL_SCAN_QUEUE_STACK_SIZE (1*1024)
#define CELL_SCAN_QUEUE_PRIORITY 5
#define CELL_SCAN_QUEUE_SIZE 2

/* ----------------------------------------------------------------
 * COMMON TASK VARIABLES
 * -------------------------------------------------------------- */
static bool exitTask = false;
static taskConfig_t *taskConfig;

/* ----------------------------------------------------------------
 * STATIC VARIABLES
 * -------------------------------------------------------------- */
static applicationStates_t tempAppStatus;

static bool stopCellScan = false;

/* ----------------------------------------------------------------
 * STATIC FUNCTIONS
 * -------------------------------------------------------------- */

static bool keepGoing(void *pParam)
{
    bool kg = !gExitApp && !exitTask && !stopCellScan;
    if (kg) {
        gAppStatus = COPS_QUERY;
        printf("Still scanning for networks...\n");
    } else {
        printf("Scanning for networks cancelled\n");
    }

    return kg;
}

static void doCellScan(void *pTopicName)
{
    int32_t found = 0;
    int32_t count = 0;
    char internalBuffer[64];
    char payload[200];
    char mccMnc[U_CELL_NET_MCC_MNC_LENGTH_BYTES];

    U_PORT_MUTEX_LOCK(TASK_MUTEX);
    SET_APP_STATUS(COPS_QUERY);

    // create the topic name
    char topic[100];
    snprintf(topic, 100, "/%s/%s", (const char *)pTopicName, NETWORK_SCAN_TOPIC);
    writeLog("Cell Scan Topic: %s", topic);

    writeLog("Scanning for networks...");
    for (count = uCellNetScanGetFirst(gDeviceHandle, internalBuffer,
                                            sizeof(internalBuffer), mccMnc, NULL,
                                            keepGoing);
            count >= 0;
            count = uCellNetScanGetNext(gDeviceHandle, internalBuffer, sizeof(internalBuffer), mccMnc, NULL)) {

        found++;
        snprintf(payload, sizeof(payload), "Cell Scan Result: found '%s', MCC/MNC: %s", internalBuffer, mccMnc);
        writeLog(payload);
        sendMQTTMessage(topic, payload, U_MQTT_QOS_AT_MOST_ONCE, false);
    }

    if (!gExitApp) {
        if(count < 0) {
            snprintf(payload, sizeof(payload), "Cell Scan Result: Error %d", count);
        } else {
            if (found == 0) {
                snprintf(payload, sizeof(payload), "Cell Scan Result: No network operators found.");
            } else {
                snprintf(payload, sizeof(payload), "Cell Scan Result: %d network(s) found in total.", found);
            }
        }
    } else {
        snprintf(payload, sizeof(payload), "Cell Scan Result: Cancelled.");
    }

    writeLog(payload);
    sendMQTTMessage(topic, payload, U_MQTT_QOS_AT_MOST_ONCE, false);

    // reset the stop cell scan indicator
    stopCellScan = false;

    REVERT_APP_STATUS();
    U_PORT_MUTEX_UNLOCK(TASK_MUTEX);
}

void startCellScan(const char *pTopicName)
{
    int32_t errorCode = uPortTaskCreate(doCellScan,
                NULL,
                CELL_SCAN_TASK_STACK_SIZE,
                (void *)pTopicName,
                CELL_SCAN_TASK_PRIORITY,
                &TASK_HANDLE);

    if (errorCode < 0) {
        writeLog("Failed to start cell scan task: %d", errorCode);
    }
}

static void queueHandler(void *pParam, size_t paramLengthBytes)
{
    cellScanMsg_t *qMsg = (cellScanMsg_t *) pParam;
    printf("cell scan message: %d", qMsg->msgType);

    switch(qMsg->msgType) {
        case START_CELL_SCAN:
            startCellScan(qMsg->msg.topicName);
            break;

        case STOP_CELL_SCAN:
            stopCellScan = true;
            break;

        case SHUTDOWN_CELL_SCAN_TASK:
            exitTask = true;
            break;

        default:
            writeLog("Unknown message type: %d", qMsg->msgType);
            break;
    }
}

static int32_t initTask(taskConfig_t *config)
{
    int32_t errorCode = U_ERROR_COMMON_SUCCESS;

    if (errorCode != 0){
        writeLog("Failed to initialise the %s task (%d). ", TASK_NAME, errorCode);
    }

    return errorCode;
}

static int32_t initMutex(taskConfig_t *config)
{
    int32_t errorCode = uPortMutexCreate(&TASK_MUTEX);
    if (errorCode != 0) {
        writeLog("Failed to create %s Mutex (%d).", TASK_NAME, errorCode);
    }

    return errorCode;
}

static int32_t initQueue(taskConfig_t *config)
{
    int32_t eventQueueHandle = uPortEventQueueOpen(&queueHandler,
                    TASK_NAME,
                    sizeof(cellScanMsg_t),
                    CELL_SCAN_QUEUE_STACK_SIZE,
                    CELL_SCAN_QUEUE_PRIORITY,
                    CELL_SCAN_QUEUE_SIZE);

    if (eventQueueHandle < 0) {
        writeLog("Failed to create %s event queue %d", TASK_NAME, eventQueueHandle);
    }

    TASK_QUEUE = eventQueueHandle;

    return eventQueueHandle;
}

/* ----------------------------------------------------------------
 * PUBLIC FUNCTIONS
 * -------------------------------------------------------------- */

/// @brief Places a Start Network Scan message on the queue
/// @param pSerialNumber the serial number of the device, for the MQTT topic name
/// @return zero if successfull, a negative value otherwise
int32_t startNetworkScan(const char *pSerialNumber)
{
    int32_t errorCode = (int32_t) U_ERROR_COMMON_SUCCESS;

    // if the mutex or queue handle is not valid, don't queue a message
    if (TASK_MUTEX == NULL || TASK_QUEUE < 0) {
        writeLog("Cell Scan Event Queue is not running, not queueing Network Scan command");
        return -1;
    }

    cellScanMsg_t msg;
    if (isTaskRunning(TASK_MUTEX)) {
        writeLog("Cell Scan is already in progress, cancelling...");
        msg.msgType = STOP_CELL_SCAN;
    } else {
        writeLog("Starting cell scan...");
        msg.msgType = START_CELL_SCAN;
        msg.msg.topicName = pSerialNumber;
    }

    errorCode = uPortEventQueueSendIrq(TASK_QUEUE, &msg, sizeof(cellScanMsg_t));
    if (errorCode != 0) {
        writeLog("Failed to queue a network scan event: %d", errorCode);
    }

    return errorCode;
}

/// @brief Starts the network scanning task(s)
/// @param pParam Any parameter to be sent to the starting of the task
/// @return zero if successfull, a negative number otherwise
int32_t startCellScanTask(taskConfig_t *config)
{
    taskConfig = config;

    int32_t result = U_ERROR_COMMON_SUCCESS;

    writeLog("Starting the %s task...", TASK_NAME);
    CHECK_SUCCESS(initTask, config);
    CHECK_SUCCESS(initQueue, config);
    CHECK_SUCCESS(initMutex, config);

    return result;
}

void stopCellScanTask(void)
{
    exitTask = true;
    writeLog("Stop %s task requested...", taskConfig->name);
}
```

## src/cellScanTask.h
```c
/*
 * Copyright 2022 u-blox
 *
 * Licensed under the Apache License, Version 2.0 (the "License");
 * you may not use this file except in compliance with the License.
 * You may obtain a copy of the License at
 *
 * http://www.apache.org/licenses/LICENSE-2.0
 *
 * Unless required by applicable law or agreed to in writing, software
 * distributed under the License is distributed on an "AS IS" BASIS,
 * WITHOUT WARRANTIES OR CONDITIONS OF ANY KIND, either express or implied.
 * See the License for the specific language governing permissions and
 * limitations under the License.
 */

/*
 *
 * Cell Scan Task to run the +COPS=? Query and publish the results
 *
 */

#ifndef _CELLSCAN_TASK_H_
#define _CELLSCAN_TASK_H_

/* ----------------------------------------------------------------
 * COMMON TASK FUNCTIONS
 * -------------------------------------------------------------- */
int32_t startCellScanTask(taskConfig_t *config);
void stopCellScanTask(void);

/* ----------------------------------------------------------------
 * TASK FUNCTIONS
 * -------------------------------------------------------------- */
int32_t startNetworkScan(const char *pSerialNumber);

/* ----------------------------------------------------------------
 * QUEUE MESSAGE TYPE DEFINITIONS
 * -------------------------------------------------------------- */
typedef enum {
    START_CELL_SCAN,            // starts the network cell scanning
    STOP_CELL_SCAN,             // stops the network cell scanning
    SHUTDOWN_CELL_SCAN_TASK,    // shuts down the 'task' by ending the mutex, queue and task.
} cellScanMsgType_t;

// Some message types are just a command, so they wont need a param/struct
typedef struct {
    cellScanMsgType_t msgType;

    union {
        const char *topicName;
    } msg;
} cellScanMsg_t;

#endif
```

## src/common.c
```c
/*
 * Copyright 2022 u-blox
 *
 * Licensed under the Apache License, Version 2.0 (the "License");
 * you may not use this file except in compliance with the License.
 * You may obtain a copy of the License at
 *
 * http://www.apache.org/licenses/LICENSE-2.0
 *
 * Unless required by applicable law or agreed to in writing, software
 * distributed under the License is distributed on an "AS IS" BASIS,
 * WITHOUT WARRANTIES OR CONDITIONS OF ANY KIND, either express or implied.
 * See the License for the specific language governing permissions and
 * limitations under the License.
 */

/*
 *
 * Common utility functions
 *
 */

#include "common.h"

/* ----------------------------------------------------------------
 * PUBLIC FUNCTIONS
 * -------------------------------------------------------------- */

/// @brief Checks if the mutex is locked
/// @param mutex the mutex of the running task
/// @return True if the mutex is locked
bool isTaskRunning(const uPortMutexHandle_t mutex)
{
    if (mutex == NULL) {
        return false;
    }

    int32_t result = uPortMutexTryLock(mutex, 0);
    if (result == 0) {
        if (uPortMutexUnlock(mutex) != 0) {
            printf("Failed to release mutex from lock check!!!");
            // now you've done it. You've tested the mutex lock
            // by locking it and now can't unlock it!!
            return true;
        }
    }

    return true;
}

/// @brief Duplicates a string via malloc - remember to free()!
/// @param src the source string
/// @returns either the duplicates string pointer, or NULL
char *uStrDup(const char *src)
{
    size_t len = strlen(src) + 1;  // String plus '\0'
    char *dst = pUPortMalloc(len); // Allocate space
    if(dst != NULL)
    {
        memcpy (dst, src, len); // Copy the block
    }

    // Return the new duplicate string
    return dst;
}

/// @brief Puts the command and param parts of a string message into a structure
/// @param message The string to parse into Command: param1, param2 etc
/// @param cmd The command structure to populate
void getParams(char *message, commandParams_t *cmd)
{
    char *rest = message;

    cmd->count = 0;
    cmd->command = strtok_r(rest, " ,:", &rest);
    for(int i=0; i<MAX_NUMBER_COMMAND_PARAMS; i++) {
        cmd->params[i] = strtok_r(rest, " ,:", &rest);
        if (cmd->params[i] != NULL)
            cmd->count++;
    }
}
```

## src/common.h
```c
/*
 * Copyright 2022 u-blox
 *
 * Licensed under the Apache License, Version 2.0 (the "License");
 * you may not use this file except in compliance with the License.
 * You may obtain a copy of the License at
 *
 * http://www.apache.org/licenses/LICENSE-2.0
 *
 * Unless required by applicable law or agreed to in writing, software
 * distributed under the License is distributed on an "AS IS" BASIS,
 * WITHOUT WARRANTIES OR CONDITIONS OF ANY KIND, either express or implied.
 * See the License for the specific language governing permissions and
 * limitations under the License.
 */

/*
 *
 * Application header
 *
 */

#ifndef _COMMON_H_
#define _COMMON_H_

#include <stdio.h>
#include <string.h>
#include <stdlib.h>

#include <stdbool.h>
#include <stdint.h>

#include "ubxlib.h"
#include "config.h"
#include "log.h"

/* ----------------------------------------------------------------
 * MACORS for common task usage/access
 * -------------------------------------------------------------- */
#define SET_APP_STATUS(x) tempAppStatus = gAppStatus; gAppStatus = x
#define REVERT_APP_STATUS(x) gAppStatus = tempAppStatus

#define CHECK_SUCCESS(x, config) result = x(config); if (result < 0) return result
#define TASK_MUTEX taskConfig->handles.mutexHandle
#define TASK_HANDLE taskConfig->handles.taskHandle
#define TASK_QUEUE taskConfig->handles.eventQueueHandle
#define TASK_NAME taskConfig->name

#define ARRAYSIZE(x) (sizeof(x) / sizeof((x)[0]))

#define MAX_NUMBER_COMMAND_PARAMS 5

/* ----------------------------------------------------------------
 * PUBLIC TYPE DEFINITIONS
 * -------------------------------------------------------------- */
// Default set of application statuses
typedef enum {
    MANUAL,
    INIT_DEVICE,
    REGISTERING,
    MQTT_CONNECTING,
    COPS_QUERY,
    SEND_SIGNAL_QUALITY,
    REGISTRATION_UNKNOWN,
    REGISTERED,
    ERROR,
    SHUTDOWN,
    MQTT_CONNECTED,
    MQTT_DISCONNECTED,
    START_SIGNAL_QUALITY,
    MAX_STATUS
} applicationStates_t;

typedef struct TaskHandles {
    uPortTaskHandle_t taskHandle;
    uPortMutexHandle_t mutexHandle;
    int32_t eventQueueHandle;
} taskHandles_t;

typedef struct TaskConfig {
    const char *name;
    void *pParameter;
    taskHandles_t handles;
} taskConfig_t;

typedef int32_t (*taskStart_t)(taskConfig_t *taskConfig);
typedef void (*taskStop_t)(void);

typedef struct TaskRunner {
    taskStart_t startFunc;
    taskStop_t stopFunc;
    taskConfig_t config;
} taskRunner_t;

typedef struct {
    const char *command;
    const char *params[MAX_NUMBER_COMMAND_PARAMS];
    int32_t count;
} commandParams_t;


/* ----------------------------------------------------------------
 * EXTERNAL VARIABLES used in the application tasks
 * -------------------------------------------------------------- */

// serial number of the cellular module
extern char gSerialNumber[U_SECURITY_SERIAL_NUMBER_MAX_LENGTH_BYTES];

// This is the ubxlib deviceHandle for communicating with the celullar module
extern uDeviceHandle_t gDeviceHandle;

// This flag is set to true when the application's tasks should exit
extern bool gExitApp;

// This flag represents the network's registration status (false = unknown state)
extern bool gIsNetworkUp;

// application status
extern applicationStates_t gAppStatus;

// our framework tasks
extern taskRunner_t tasks[];

/* ----------------------------------------------------------------
 * PUBLIC FUNCTIONS
 * -------------------------------------------------------------- */
bool isTaskRunning(const uPortMutexHandle_t mutex);
char *uStrDup(const char *src);

int32_t sendAppTaskMessage(int32_t taskId, const void *pMessage, size_t msgSize);

// subscribe a callback function to a topic
void subscribeToTopicAsync(const char *taskTopicName, uMqttQos_t qos, void (*callbackFunction)(const char *, size_t));

// Simple function to split message into command/params structure
void getParams(char *message, commandParams_t *cmd);

#endif
```

## src/config.h
```c
/*
 * Copyright 2022 u-blox
 *
 * Licensed under the Apache License, Version 2.0 (the "License");
 * you may not use this file except in compliance with the License.
 * You may obtain a copy of the License at
 *
 * http://www.apache.org/licenses/LICENSE-2.0
 *
 * Unless required by applicable law or agreed to in writing, software
 * distributed under the License is distributed on an "AS IS" BASIS,
 * WITHOUT WARRANTIES OR CONDITIONS OF ANY KIND, either express or implied.
 * See the License for the specific language governing permissions and
 * limitations under the License.
 */

/*
 *
 * Configuration header.
 *  Contains:
 *      MQTT Broker IP address
 *      MQTT Broker Username
 *      MQTT Broker Password
 *
 *      MNO APN to use for cellular network registration
 *
 */

#ifndef _CONFIG_APP_H_
#define _CONFIG_APP_H_

#define BROKER_NAME "xx.xxx.xxx.xx"
#define USERNAME "username"
#define PASSWORD "password"

#define APN "apn-name"

#endif
```
